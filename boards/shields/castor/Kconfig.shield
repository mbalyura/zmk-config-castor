## boards/shields/castor/Kconfig.shield
```kconfig
config SHIELD_CASTOR_LEFT
	def_bool $(shields_list_contains,castor_left)
config SHIELD_CASTOR_RIGHT
	def_bool $(shields_list_contains,castor_right)
```

## config/west.yml
```yaml
manifest:
  remotes:
    - name: zmkfirmware
      url-base: https://github.com/zmkfirmware
    - name: infused-kim
      url-base: https://github.com/infused-kim
    - name: badjeff
      url-base: https://github.com/badjeff
    - name: dhruvinsh
      url-base: https://github.com/dhruvinsh
  projects:
    - name: zmk
      remote: zmkfirmware
      revision: main
      import: app/west.yml
    # Module for PS/2 mouse & TP driver
    # - name: kb_zmk_ps2_mouse_trackpoint_driver
    #   remote: infused-kim
    #   revision: main
    - name: kb_zmk_ps2_mouse_trackpoint_driver
      remote: badjeff
      revision: main
    # - name: zmk-tri-state
    #   remote: dhruvinsh
    #   revision: main
  self:
    path: config
```
